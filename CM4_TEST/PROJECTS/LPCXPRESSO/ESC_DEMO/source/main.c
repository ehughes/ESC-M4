

#include "board.h"
#include "fsl_debug_console.h"
#include "fsl_emc.h"
#include "pin_mux.h"
#include <stdio.h>
#include <string.h>
#include <stdbool.h>

#include "eGFX.h"
#include "eGFX_Driver.h"
#include "FONT_5_7_1BPP.h"
#include "pin_mux.h"
#include "fsl_device_registers.h"
#include "fsl_i2c.h"
#include "fsl_i2s.h"
#include "fsl_wm8904.h"
#include "Audio.h"
#include "fsl_iocon.h"
#include "fsl_common.h"
#include "clock_config.h"
#include "fsl_power.h"
#include "fsl_i2c.h"
#include "fsl_ft5406.h"
#include "arm_math.h"
#include "Sprites_16BPP_565.h"



#include "OCR_A_Extended__20px__Bold__SingleBitPerPixelGridFit_1BPP.h"
#include "Consolas__26px__Regular__AntiAliasGridFit_1BPP.h"
#include "Magneto__26px__Regular__AntiAliasGridFit_16BPP_565.h" 

volatile uint32_t NextSampleOut = 0;
volatile uint32_t RequestBuffer = 0;
volatile uint32_t BufferIndex = 0;

#define BUFFER_SIZE	512

volatile float MicBuffer[BUFFER_SIZE];

void DMIC0_IRQHandler()
{
	int16_t NextSampleIn;

	/*
			This is the IRQ handler for the DMIC.   When the DMIC FIFO gets to a
			preprogrammed level,  and interrupt will be generate and we will end up here!
 */

  /*
			there are several possible interrupt source from the DMIC FIFO.
	     Check to see that it was the INT flag
   */
	if(DMIC0->CHANNEL[1].FIFO_STATUS & DMIC_CHANNEL_FIFO_STATUS_INT_MASK)
	{

		DMIC0->CHANNEL[1].FIFO_STATUS |= DMIC_CHANNEL_FIFO_STATUS_INT_MASK;


		NextSampleIn = (int16_t)(DMIC0->CHANNEL[1].FIFO_DATA);


		if(RequestBuffer)
		{
			MicBuffer[BufferIndex] = (float)((NextSampleIn))  /  ((float)(1<<15));
			BufferIndex++;

			if(BufferIndex == BUFFER_SIZE)
			{
				RequestBuffer = 0;
				BufferIndex = 0;
			}
		}
  }
}

arm_rfft_fast_instance_f32 MyFFT;

float	FFT_RawDataOut[BUFFER_SIZE];
float   FFT_PowerSpectrum[BUFFER_SIZE];

const float Hanning[512] = {
0.00000000,0.00003780,0.00015118,0.00034013,0.00060463,0.00094463,0.00136008,0.00185091,0.00241706,0.00305844,0.00377495,0.00456648,0.00543291,0.00637411,0.00738995,0.00848026,
0.00964488,0.01088363,0.01219634,0.01358279,0.01504278,0.01657609,0.01818249,0.01986173,0.02161357,0.02343773,0.02533393,0.02730190,0.02934134,0.03145193,0.03363337,0.03588531,0.03820741,
0.04059934,0.04306072,0.04559118,0.04819034,0.05085781,0.05359319,0.05639605,0.05926599,0.06220255,0.06520531,0.06827379,0.07140755,0.07460611,0.07786898,0.08119567,0.08458568,0.08803850,
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0.00015118,0.00003780,0.00000000};


uint32_t Window= 0;

int main(void)
{

		//Some temporary variables for reading the touch screen
  	int32_t x=10,y=10;
		
	 //We are going to make a variable that stores the coordinate of the slider. 
	 //I will initialize the value to somewhere in the middle
  

	
		//some variables for the touch screen driver
    ft5406_handle_t touch_handle;
   
		touch_event_t touch_event;
	
	


  	/* USART0 clock */
    CLOCK_AttachClk(BOARD_DEBUG_UART_CLK_ATTACH);

    /* Initialize the rest */
    BOARD_InitPins();
	
    BOARD_BootClockPLL180M();
  
	BOARD_InitSPIFI_ExternalFlash();

	BOARD_InitSDRAM();

	eGFX_InitDriver();
	 
	Init_DMIC();

	FT5406_Init(&touch_handle,I2C2);

	arm_rfft_fast_init_f32(&MyFFT,BUFFER_SIZE);  //Init a 512 Point FFT

		while(1)
		{
	
			RequestBuffer = 1;

			while(RequestBuffer == 1)
			{

			}

			 if (kStatus_Success == FT5406_GetSingleTouch(&touch_handle, &touch_event, &y, &x))
		       {
		          if (touch_event == kTouch_Down)
		          {
						Window^=1;
		         }
		       }

				 for(int i=0; i<480*272/2;i++)
				 {
					*((uint32_t *)(eGFX_BackBuffer.Data) + i) = 0xFFFFFFFF;
				 }

				 if(Window == 1)
				 {
					 for (int i=0;i<512;i++)
					 {
						 MicBuffer[i] = MicBuffer[i] * Hanning[i];
					 }
				 }

				 for(int i=1;i<eGFX_PHYSICAL_SCREEN_SIZE_X;i++)
						 {


						 	float Point1 = (MicBuffer[i-1]*(eGFX_PHYSICAL_SCREEN_SIZE_Y/2));

						 	float Point2 = (MicBuffer[i]*(eGFX_PHYSICAL_SCREEN_SIZE_Y/2));


						 	eGFX_DrawLine(&eGFX_BackBuffer,
						 					i-1		,		Point1+eGFX_PHYSICAL_SCREEN_SIZE_Y/2,
						 					i+1		  ,   Point2+eGFX_PHYSICAL_SCREEN_SIZE_Y/2,
						 					eGFX_RGB888_TO_RGB565(0,0,0)
											);

						 	eGFX_DrawLine(&eGFX_BackBuffer,
						 					i-1		,		Point1+eGFX_PHYSICAL_SCREEN_SIZE_Y/2 + 1,
						 					i+1			,   Point2+eGFX_PHYSICAL_SCREEN_SIZE_Y/2 + 1,
						 					eGFX_RGB888_TO_RGB565(0,0,0)
						 					);
						 	eGFX_DrawLine(&eGFX_BackBuffer,
						 						i-1		,		Point1+eGFX_PHYSICAL_SCREEN_SIZE_Y/2 - 1,
						 						i+1		  ,		Point2+eGFX_PHYSICAL_SCREEN_SIZE_Y/2 - 1,
						 						eGFX_RGB888_TO_RGB565(0,0,0)
						 						);


						 }


				 if(Window)
				 {
					eGFX_printf_HorizontalCentered_Colored(&eGFX_BackBuffer,
																2,
																&OCR_A_Extended__20px__Bold__SingleBitPerPixelGridFit_1BPP,
																eGFX_RGB888_TO_RGB565(0,0,0),
																"ARM Cortex M4 CMSIS DSP Example [Hanning]");
				 }
				 else
				 {
						eGFX_printf_HorizontalCentered_Colored(&eGFX_BackBuffer,
																				2,
																				&OCR_A_Extended__20px__Bold__SingleBitPerPixelGridFit_1BPP,
																				eGFX_RGB888_TO_RGB565(0,0,0),
																				"ARM Cortex M4 CMSIS DSP Example [Rect]");
				 }

					eGFX_Blit(&eGFX_BackBuffer,
									eGFX_PHYSICAL_SCREEN_SIZE_X/2 - Sprite_16BPP_565_monkey.SizeX/2 + 1,  //x coordinate of where to put the monkey head
									30,																			 //y coordinate of where to put the monkey head
									&Sprite_16BPP_565_monkey);



					  arm_rfft_fast_f32(&MyFFT,
													  (float *)MicBuffer,
															   FFT_RawDataOut,
															   0);

									 arm_cmplx_mag_squared_f32(FFT_RawDataOut,
													  		    FFT_PowerSpectrum,
															    BUFFER_SIZE/2
															);

				for(int i=0;i<eGFX_PHYSICAL_SCREEN_SIZE_X/2;i++)
				{
					eGFX_DrawVline(&eGFX_BackBuffer, eGFX_PHYSICAL_SCREEN_SIZE_Y-2,
							eGFX_PHYSICAL_SCREEN_SIZE_Y - 2 - (FFT_PowerSpectrum[i+10])*2, i*2, eGFX_RGB888_TO_RGB565(255,32,0));
					eGFX_DrawVline(&eGFX_BackBuffer, eGFX_PHYSICAL_SCREEN_SIZE_Y-2,
											eGFX_PHYSICAL_SCREEN_SIZE_Y - 2 - (FFT_PowerSpectrum[i+10])*2, i*2+1, eGFX_RGB888_TO_RGB565(255,32,32));
				}
			

		
			  //The last step is to dump the backbuffer to the screen.
				eGFX_Dump(&eGFX_BackBuffer);
		}
}



