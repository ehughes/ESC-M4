# LPC5411x register map
File version: 0.3
LPC5411x Cortex-M4 MCU; Cortex-M0+ coprocessor
CPU: CM4 r0p0, little endian, MPU, FPU, 3 interrupt priority bits
Registers are 32-bit, read-write, reset 0x0 unless marked. A register's access mark holds for its fields unless they carry their own. Offsets are from the block's base; lines under a group give offsets from that group; [hi:lo] are bit positions; {n}, {i} and the like mark numbered series; 'fields as' and 'values as' point back to an identical list; <NAME> marks a mode.

## Memory map
0x40000000 SYSCON size 0x1000 — System configuration
0x40001000 IOCON size 0x1000 — I/O pin configuration
0x40002000 GINT0 size 0x1000 — Group GPIO input interrupt 0
0x40003000 GINT1 size 0x1000 — Group GPIO input interrupt 1
0x40004000 PINT size 0x1000 — Pin interrupt and pattern match engine
0x40005000 INPUTMUX size 0x1000 — Input multiplexing
0x40008000 CT32B0 size 0x1000 — Standard counter/timer 0
0x40009000 CT32B1 size 0x1000 — Standard counter/timer 1
0x4000C000 WWDT size 0x1000 — Windowed Watchdog Timer
0x4000D000 MRT size 0x1000 — Multi-Rate Timer
0x4000E000 UTICK size 0x1000 — Micro-tick timer
0x40028000 CT32B2 size 0x1000 — Standard counter/timer 2
0x4002C000 ADVSYSCON size 0x1000 — Advanced System configuration
0x4002C000 RTC size 0x1000 — Real-Time Clock
0x40048000 CT32B3 size 0x1000 — Standard counter/timer 3
0x40049000 CT32B4 size 0x1000 — Standard counter/timer 4
0x40080000 ASYNCSYSCON size 0x1000 — Asynchronous system configuration
0x40082000 DMA size 0x1000 — DMA controller
0x40084000 USART0 size 0x1000
0x40085000 SCT0 size 0x1000 — State Configurable Timer/PWM 0
0x40088000 USART1 size 0x1000
0x4008B000 MAILBOX size 0x1000
0x4008C000 GPIO size 0x2304 — General Purpose I/O
0x4008C000 USART2 size 0x1000
0x40090000 USART3 size 0x1000
0x40094000 I2C0 size 0x1000 — I2C-bus interface 0
0x40095000 CRC size 0x1000 — CRC engine
0x40098000 I2C1 size 0x1000 — I2C-bus interface 1
0x4009C000 I2C2 size 0x1000 — I2C-bus interface 2
0x400A0000 ADC0 size 0x1000 — 12-bit ADC controller 0
0x400A4000 SPI0 size 0x1000
0x400A8000 SPI1 size 0x1000

## Interrupts
0 WDT (WWDT)
1 BOD (ADVSYSCON)
3 DMA
4 GINT0
5 PIN_INT0 (PINT)
6 PIN_INT1 (PINT)
7 PIN_INT2 (PINT)
8 PIN_INT3 (PINT)
9 UTICK
10 MRT
11 CT32B0
12 CT32B1
13 CT32B2
14 CT32B3
15 CT32B4
16 SCT0
17 UART0 (USART0)
18 UART1 (USART1)
19 UART2 (USART2)
20 UART3 (USART3)
21 I2C0
22 I2C1
23 I2C2
24 SPI0
25 SPI1
26 ADC_SEQA (ADC0)
27 ADC_SEQB (ADC0)
28 ADC_THCMP (ADC0)
29 RTC
31 MAILBOX
32 GINT1
33 PIN_INT4 (PINT)
34 PIN_INT5 (PINT)
35 PIN_INT6 (PINT)
36 PIN_INT7 (PINT)

## GPIO — General Purpose I/O
Base 0x4008C000
{0x0+i} B{i} (i=0..49) 1-bit reset not defined — Byte pin registers port 0/1; pins PIO0_0 to PIO1_8
  [0] PBYTE — Read: state of the pin PIOm_n, regardless of direction, masking, or alternate function, except that pins configured as analog I/O always read as 0. One register for each port pin. Supported pins depends on the specific device and package. Write: loads the pins output bit. One register for each port pin. Supported pins depends on the specific device and package.
{0x1000+4i} W{i} (i=0..49) reset not defined — Word pin registers port 0/1; pins PIO0_0 to PIO1_8
  [31:0] PWORD — Read 0: pin PIOm_n is LOW. Write 0: clear output bit. Read 0xFFFF FFFF: pin PIOm_n is HIGH. Write any value 0x0000 0001 to 0xFFFF FFFF: set output bit. Only 0 or 0xFFFF FFFF can be read. Writing any value other than 0 will set the output bit. One register for each port pin. Supported pins depends on the specific device and package.
{0x2000+4i} DIR{i} (i=0..1) — Direction registers port 0/1
  [31:0] DIRP — Selects pin direction for pin PIOm_n. Supported pins depends on the specific device and package. 0 = input. 1 = output.
{0x2080+4i} MASK{i} (i=0..1) — Mask register port 0/1
  [31:0] MASKP — Controls which bits corresponding to PIOm_n are active in the MPORT register. Supported pins depends on the specific device and package. 0 = Read MPORT: pin state; write MPORT: load output bit. 1 = Read MPORT: 0; write MPORT: output bit not affected.
{0x2100+4i} PIN{i} (i=0..1) reset not defined — Port pin register port 0/1
  [31:0] PORT — Reads pin states or loads output bits. Supported pins depends on the specific device and package. 0 = Read: pin is low; write: clear output bit. 1 = Read: pin is high; write: set output bit.
{0x2180+4i} MPIN{i} (i=0..1) reset not defined — Masked port register port 0/1
  [31:0] MPORTP — Masked port register. Supported pins depends on the specific device and package. 0 = Read: pin is LOW and/or the corresponding bit in the MASK register is 1; write: clear output bit if the corresponding bit in the MASK register is 0. 1 = Read: pin is HIGH and the corresponding bit in the MASK register is 0; write: set output bit if the corresponding bit in the MASK register is 0.
{0x2200+4i} SET{i} (i=0..1) — Write: Set register for port 0/1 Read: output bits for port 0/1
  [31:0] SETP — Read or set output bits. Supported pins depends on the specific device and package. 0 = Read: output bit: write: no operation. 1 = Read: output bit; write: set output bit.
{0x2280+4i} CLR{i} (i=0..1) wo reset not defined — Clear port 0/1
  [31:0] CLRP — Clear output bits. Supported pins depends on the specific device and package. 0 = No operation. 1 = Clear output bit.
{0x2300+4i} NOT{i} (i=0..1) wo reset not defined — Toggle port 0/1
  [31:0] NOTP — Toggle output bits. Supported pins depends on the specific device and package. 0 = no operation. 1 = Toggle output bit.
